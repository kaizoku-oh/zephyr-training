/ {
    aliases {
        training-led = &led2_subnode_label;
    };


    led_childnode: led_childnode_path {
        compatible = "gpio-leds";

        led2_subnode_label: led1_path {
            gpios = <&gpiob 7 GPIO_ACTIVE_HIGH>;
               };
    };
};
